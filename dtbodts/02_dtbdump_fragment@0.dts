/dts-v1/;

/ {

	__fixups__ {
		accdet = "/fragment@6:target:0";
		auxadc = "/fragment@18:target:0", "/fragment@19/__overlay__:io-channels:0";
		chosen = "/fragment@1:target:0";
		consys = "/fragment@14:target:0";
		dsi_te = "/fragment@38:target:0";
		goodix_fp = "/fragment@37:target:0";
		gpio = "/fragment@32:target:0";
		gpio_usage_mapping = "/fragment@31:target:0";
		i2c0 = "/fragment@2:target:0", "/fragment@21:target:0";
		i2c1 = "/fragment@22:target:0";
		i2c2 = "/fragment@5:target:0", "/fragment@23:target:0";
		i2c3 = "/fragment@24:target:0";
		i2c4 = "/fragment@25:target:0";
		i2c5 = "/fragment@26:target:0";
		i2c6 = "/fragment@27:target:0";
		i2c7 = "/fragment@28:target:0";
		i2c8 = "/fragment@29:target:0";
		i2c9 = "/fragment@30:target:0";
		irtx_pwm = "/fragment@16:target:0";
		kd_camera_hw1 = "/fragment@45:target:0";
		keypad = "/fragment@47:target:0";
		main_pmic = "/fragment@41:target:0";
		md1_sim1_hot_plug_eint = "/fragment@42:target:0";
		md_auxadc = "/fragment@19:target:0";
		mrdump_ext_rst = "/fragment@33:target:0";
		msdc1_ins = "/fragment@36:target:0";
		mt6360_pmu = "/fragment@10:target:0";
		mt6360_typec = "/fragment@11:target:0";
		mt_pmic_vcamio_ldo_reg = "/fragment@43:target:0", "/fragment@45/__overlay__:vcamio-supply:0", "/fragment@45/__overlay__:vcamio_sub-supply:0", "/fragment@45/__overlay__:vcamio_main2-supply:0", "/fragment@45/__overlay__:vcamaf-supply:0", "/fragment@45/__overlay__:vcamaf_main2-supply:0";
		mt_pmic_vtp_ldo_reg = "/fragment@2/__overlay__/gt9886@5d:vtouch-supply:0", "/fragment@44:target:0", "/fragment@45/__overlay__:vcamaf_sub2-supply:0";
		mtkfb = "/fragment@9:target:0";
		odm = "/fragment@7:target:0";
		pio = "/fragment@2/__overlay__/gt9886@5d:interrupt-parent:0", "/fragment@2/__overlay__/gt9886@5d:goodix,reset-gpio:0", "/fragment@2/__overlay__/gt9886@5d:goodix,irq-gpio:0", "/fragment@4:target:0", "/fragment@8:target:0", "/fragment@10/__overlay__:mt6360,intr_gpio:0", "/fragment@11/__overlay__:mt6360pd,intr_gpio:0", "/fragment@12:target:0", "/fragment@13:target:0", "/fragment@17:target:0", "/fragment@31/__overlay__:GPIO_SIM1_SIO:0", "/fragment@31/__overlay__:GPIO_SIM1_SRST:0", "/fragment@31/__overlay__:GPIO_SIM1_SCLK:0", "/fragment@31/__overlay__:GPIO_SIM2_SCLK:0", "/fragment@31/__overlay__:GPIO_SIM2_SRST:0", "/fragment@31/__overlay__:GPIO_SIM2_SIO:0", "/fragment@31/__overlay__:GPIO_SIM1_HOT_PLUG:0", "/fragment@31/__overlay__:GPIO_SIM2_HOT_PLUG:0", "/fragment@33/__overlay__:interrupt-parent:0", "/fragment@33/__overlay__:deb-gpios:0", "/fragment@34/__overlay__:interrupt-parent:0", "/fragment@35/__overlay__:interrupt-parent:0", "/fragment@36/__overlay__:interrupt-parent:0", "/fragment@37/__overlay__:interrupt-parent:0", "/fragment@38/__overlay__:interrupt-parent:0", "/fragment@39/__overlay__:interrupt-parent:0", "/fragment@40/__overlay__:interrupt-parent:0", "/fragment@41/__overlay__:interrupt-parent:0";
		pmic_clock_buffer_ctrl = "/fragment@20:target:0";
		reserved_memory = "/fragment@0:target:0";
		smart_pa = "/fragment@40:target:0";
		snd_audio_dsp = "/fragment@15:target:0";
		subpmic_pmu_eint = "/fragment@39:target:0";
		tcpc_pd = "/fragment@35:target:0";
		touch = "/fragment@3:target:0", "/fragment@34:target:0", "/fragment@46:target:0";
	};

	__local_fixups__ {

		fragment@14 {

			__overlay__ {
				pinctrl-0 = <0x0>;
				pinctrl-1 = <0x0>;
				pinctrl-2 = <0x0>;
				pinctrl-3 = <0x0>;
			};
		};

		fragment@16 {

			__overlay__ {
				pinctrl-0 = <0x0>;
				pinctrl-1 = <0x0>;
			};
		};

		fragment@2 {

			__overlay__ {
				pinctrl-0 = <0x0>;
				pinctrl-1 = <0x0>;
				pinctrl-2 = <0x0>;
				pinctrl-3 = <0x0>;
				pinctrl-4 = <0x0>;
			};
		};

		fragment@3 {

			__overlay__ {
				pinctrl-0 = <0x0>;
				pinctrl-1 = <0x0>;
				pinctrl-2 = <0x0>;
				pinctrl-3 = <0x0>;
				pinctrl-4 = <0x0>;
				pinctrl-5 = <0x0>;
			};
		};

		fragment@7 {

			__overlay__ {

				usb_c_pinctrl {
					pinctrl-0 = <0x0>;
					pinctrl-1 = <0x0>;
					pinctrl-10 = <0x0>;
					pinctrl-11 = <0x0>;
					pinctrl-12 = <0x0>;
					pinctrl-2 = <0x0>;
					pinctrl-3 = <0x0>;
					pinctrl-4 = <0x0>;
					pinctrl-5 = <0x0>;
					pinctrl-6 = <0x0>;
					pinctrl-7 = <0x0>;
					pinctrl-8 = <0x0>;
					pinctrl-9 = <0x0>;
				};
			};
		};

		fragment@9 {

			__overlay__ {
				pinctrl-0 = <0x0>;
				pinctrl-1 = <0x0>;
				pinctrl-2 = <0x0>;
				pinctrl-3 = <0x0>;
				pinctrl-4 = <0x0>;
				pinctrl-5 = <0x0>;
				pinctrl-6 = <0x0>;
			};
		};
	};

	__symbols__ {
		camera_main_af_mtk = "/fragment@23/__overlay__/camera_main_af@0c";
		camera_main_eeprom_mtk = "/fragment@23/__overlay__/camera_main_eeprom@50";
		camera_main_mtk = "/fragment@23/__overlay__/camera_main@1a";
		camera_main_two_af_mtk = "/fragment@28/__overlay__/camera_main_two_af@0c";
		camera_main_two_eeprom_mtk = "/fragment@28/__overlay__/camera_main_two_eeprom@50";
		camera_main_two_mtk = "/fragment@28/__overlay__/camera_main_two@10";
		camera_sub_eeprom_mtk = "/fragment@25/__overlay__/camera_sub_eeprom@52";
		camera_sub_mtk = "/fragment@25/__overlay__/camera_sub@2d";
		camera_sub_two_af_mtk = "/fragment@25/__overlay__/camera_sub_two_af@18";
		camera_sub_two_eeprom_mtk = "/fragment@25/__overlay__/camera_sub_two_eeprom@a2";
		camera_sub_two_mtk = "/fragment@25/__overlay__/camera_sub_two@2e";
		cap_touch_mtk = "/fragment@21/__overlay__/cap_touch@14";
		ccu_sensor_i2c_main2_hw_mtk = "/fragment@28/__overlay__/ccu_sensor_i2c_main2_hw@36";
		ccu_sensor_i2c_main3_hw_mtk = "/fragment@28/__overlay__/ccu_sensor_i2c_main3_hw@11";
		ccu_sensor_i2c_main_hw_mtk = "/fragment@23/__overlay__/ccu_sensor_i2c_main_hw@33";
		ccu_sensor_i2c_sub2_hw_mtk = "/fragment@25/__overlay__/ccu_sensor_i2c_sub2_hw@12";
		ccu_sensor_i2c_sub_hw_mtk = "/fragment@25/__overlay__/ccu_sensor_i2c_sub_hw@43";
		consys_pins_default = "/fragment@13/__overlay__/consys_default";
		ctp_pins_default = "/fragment@4/__overlay__/eint0default";
		ctp_pins_eint_as_int = "/fragment@4/__overlay__/eint@0";
		ctp_pins_eint_output0 = "/fragment@4/__overlay__/eintoutput0";
		ctp_pins_eint_output1 = "/fragment@4/__overlay__/eintoutput1";
		ctp_pins_rst_output0 = "/fragment@4/__overlay__/rstoutput0";
		ctp_pins_rst_output1 = "/fragment@4/__overlay__/rstoutput1";
		ctp_ts_int_active = "/fragment@4/__overlay__/int_active";
		ctp_ts_int_suspend = "/fragment@4/__overlay__/int_suspend";
		ctp_ts_pins_default = "/fragment@4/__overlay__/eint1default";
		ctp_ts_reset_active = "/fragment@4/__overlay__/reset_active";
		ctp_ts_reset_suspend = "/fragment@4/__overlay__/reset_suspend";
		gpio_redriver_c1_high = "/fragment@12/__overlay__/c1_high";
		gpio_redriver_c1_hiz = "/fragment@12/__overlay__/c1_highz";
		gpio_redriver_c1_init = "/fragment@12/__overlay__/c1_init";
		gpio_redriver_c1_low = "/fragment@12/__overlay__/c1_low";
		gpio_redriver_c2_high = "/fragment@12/__overlay__/c2_high";
		gpio_redriver_c2_hiz = "/fragment@12/__overlay__/c2_highz";
		gpio_redriver_c2_init = "/fragment@12/__overlay__/c2_init";
		gpio_redriver_c2_low = "/fragment@12/__overlay__/c2_low";
		gpio_u3_switch_disable = "/fragment@12/__overlay__/u3_sw_dis";
		gpio_u3_switch_enable = "/fragment@12/__overlay__/u3_sw_en";
		gpio_u3_switch_sel1 = "/fragment@12/__overlay__/u3_sw_sel1";
		gpio_u3_switch_sel2 = "/fragment@12/__overlay__/u3_sw_sel2";
		gpslna_pins_init = "/fragment@13/__overlay__/gpslna@0";
		gpslna_pins_oh = "/fragment@13/__overlay__/gpslna@1";
		gpslna_pins_ol = "/fragment@13/__overlay__/gpslna@2";
		i2c_lcd_bias_mtk = "/fragment@21/__overlay__/i2c_lcd_bias@11";
		irtx_gpio_led_default = "/fragment@17/__overlay__/irtx_gpio_led_def@gpio26";
		irtx_gpio_led_set = "/fragment@17/__overlay__/irtx_gpio_led_set@gpio26";
		led0 = "/fragment@7/__overlay__/led@0";
		led1 = "/fragment@7/__overlay__/led@1";
		led2 = "/fragment@7/__overlay__/led@2";
		led3 = "/fragment@7/__overlay__/led@3";
		led4 = "/fragment@7/__overlay__/led@4";
		led5 = "/fragment@7/__overlay__/led@5";
		led6 = "/fragment@7/__overlay__/led@6";
		mtkfb_pins_lcd_bias_enn0 = "/fragment@8/__overlay__/lcd_bias_enn0_gpio";
		mtkfb_pins_lcd_bias_enn1 = "/fragment@8/__overlay__/lcd_bias_enn1_gpio";
		mtkfb_pins_lcd_bias_enp0 = "/fragment@8/__overlay__/lcd_bias_enp0_gpio";
		mtkfb_pins_lcd_bias_enp1 = "/fragment@8/__overlay__/lcd_bias_enp1_gpio";
		mtkfb_pins_lcm_dsi_te = "/fragment@8/__overlay__/lcm_dsi_te";
		mtkfb_pins_lcm_rst_out0_gpio = "/fragment@8/__overlay__/lcm_rst_out0_gpio";
		mtkfb_pins_lcm_rst_out1_gpio = "/fragment@8/__overlay__/lcm_rst_out1_gpio";
		nfc_mtk = "/fragment@24/__overlay__/nfc@08";
		speaker_amp_mtk = "/fragment@27/__overlay__/speaker_amp@34";
		subpmic_ldo_mtk = "/fragment@26/__overlay__/subpmic_ldo@64";
		subpmic_mtk = "/fragment@26/__overlay__/subpmic@34";
		subpmic_pmic_mtk = "/fragment@26/__overlay__/subpmic_pmic@1a";
		usb_c_pinctrl = "/fragment@7/__overlay__/usb_c_pinctrl";
		usb_default = "/fragment@12/__overlay__/usb_default";
		usb_type_c_mtk = "/fragment@26/__overlay__/usb_type_c@4e";
		vibrator0 = "/fragment@7/__overlay__/vibrator@0";
		vproc_buck_mtk = "/fragment@30/__overlay__/vproc_buck@6b";
	};

	fragment@0 {
		target = <0xffffffff>;

		__overlay__ {
		};
	};

	fragment@1 {
		target = <0xffffffff>;

		__overlay__ {
			atag,videolfb-fb_base_h = <0x0>;
			atag,videolfb-fb_base_l = "~`P";
			atag,videolfb-fps = <0x1770>;
			atag,videolfb-islcm_inited = <0x0>;
			atag,videolfb-islcmfound = <0x1>;
			atag,videolfb-lcmname = "nt35695_fhd_dsi_cmd_truly_rt5081_drv";
			atag,videolfb-vramSize = <0x17e8000>;
		};
	};

	fragment@10 {
		target = <0xffffffff>;

		__overlay__ {
			mt6360,intr_gpio = <0xffffffff 0x10 0x0>;
			mt6360,intr_gpio_num = <0x10>;
		};
	};

	fragment@11 {
		target = <0xffffffff>;

		__overlay__ {
			mt6360pd,intr_gpio = <0xffffffff 0x7 0x0>;
			mt6360pd,intr_gpio_num = <0x7>;
		};
	};

	fragment@12 {
		target = <0xffffffff>;

		__overlay__ {

			c1_high {
				phandle = <0x10>;

				pins_cmd_dat {
					output-high;
					pinmux = <0x1f00>;
					slew-rate = <0x1>;
				};
			};

			c1_highz {
				phandle = <0xf>;

				pins_cmd_dat {
					bias-disable;
					pinmux = <0x1f00>;
					slew-rate = <0x0>;
				};
			};

			c1_init {
				phandle = <0xd>;

				pins_cmd_dat {
					output-low;
					pinmux = <0x1f00>;
					slew-rate = <0x1>;
				};
			};

			c1_low {
				phandle = <0xe>;

				pins_cmd_dat {
					output-low;
					pinmux = <0x1f00>;
					slew-rate = <0x1>;
				};
			};

			c2_high {
				phandle = <0x14>;

				pins_cmd_dat {
					output-high;
					pinmux = <0x1e00>;
					slew-rate = <0x1>;
				};
			};

			c2_highz {
				phandle = <0x13>;

				pins_cmd_dat {
					bias-disable;
					pinmux = <0x1e00>;
					slew-rate = <0x0>;
				};
			};

			c2_init {
				phandle = <0x11>;

				pins_cmd_dat {
					output-low;
					pinmux = <0x1e00>;
					slew-rate = <0x1>;
				};
			};

			c2_low {
				phandle = <0x12>;

				pins_cmd_dat {
					output-low;
					pinmux = <0x1e00>;
					slew-rate = <0x1>;
				};
			};

			u3_sw_dis {
				phandle = <0x18>;
			};

			u3_sw_en {
				phandle = <0x17>;
			};

			u3_sw_sel1 {
				phandle = <0x15>;

				pins_cmd_dat {
					output-low;
					pinmux = <0x2000>;
					slew-rate = <0x1>;
				};
			};

			u3_sw_sel2 {
				phandle = <0x16>;

				pins_cmd_dat {
					output-high;
					pinmux = <0x2000>;
					slew-rate = <0x1>;
				};
			};

			usb_default {
				phandle = <0xc>;
			};
		};
	};

	fragment@13 {
		target = <0xffffffff>;

		__overlay__ {

			consys_default {
				phandle = <0x20>;
			};

			gpslna@0 {
				phandle = <0x21>;

				pins_cmd_dat {
					bias-disable;
					output-low;
					pinmux = <0x4a00>;
					slew-rate = <0x0>;
				};
			};

			gpslna@1 {
				phandle = <0x22>;

				pins_cmd_dat {
					output-high;
					pinmux = <0x4a00>;
					slew-rate = <0x1>;
				};
			};

			gpslna@2 {
				phandle = <0x23>;

				pins_cmd_dat {
					output-low;
					pinmux = <0x4a00>;
					slew-rate = <0x1>;
				};
			};
		};
	};

	fragment@14 {
		target = <0xffffffff>;

		__overlay__ {
			pinctrl-0 = <0x20>;
			pinctrl-1 = <0x21>;
			pinctrl-2 = <0x22>;
			pinctrl-3 = <0x23>;
			pinctrl-names = "default", "gps_lna_state_init", "gps_lna_state_oh", "gps_lna_state_ol";
			status = "okay";
		};
	};

	fragment@15 {
		target = <0xffffffff>;

		__overlay__ {
			mtk_dsp_a2dp = <0x0 0xffffffff 0xffffffff 0xffffffff>;
			mtk_dsp_call_final = <0x1 0x4 0xf 0x13>;
			mtk_dsp_capture1 = <0x1 0xffffffff 0xc 0x12>;
			mtk_dsp_dataprovider = <0x0 0xffffffff 0xf 0xffffffff>;
			mtk_dsp_deep = <0x0 0x3 0xffffffff 0xffffffff>;
			mtk_dsp_offload = <0x0 0x6 0xffffffff 0xffffffff>;
			mtk_dsp_playback = <0x1 0x4 0xf 0x13>;
			mtk_dsp_primary = <0x0 0x0 0xffffffff 0xffffffff>;
			mtk_dsp_voip = <0x1 0x1 0xffffffff 0xffffffff>;
			swdsp_smartpa_process_enable = <0x1>;
		};
	};

	fragment@16 {
		target = <0xffffffff>;

		__overlay__ {
			pinctrl-0 = <0x24>;
			pinctrl-1 = <0x25>;
			pinctrl-names = "irtx_gpio_led_default", "irtx_gpio_led_set";
			status = "okay";
		};
	};

	fragment@17 {
		target = <0xffffffff>;

		__overlay__ {

			irtx_gpio_led_def@gpio26 {
				phandle = <0x24>;

				pins_cmd_dat {
					bias-disable;
					input-schmitt-enable = <0x0>;
					output-low;
					pinmux = <0x1a00>;
					slew-rate = <0x1>;
				};
			};

			irtx_gpio_led_set@gpio26 {
				phandle = <0x25>;

				pins_cmd_dat {
					output-high;
					pinmux = <0x1a01>;
					slew-rate = <0x1>;
				};
			};
		};
	};

	fragment@18 {
		target = <0xffffffff>;

		__overlay__ {

			adc_channel@ {
				compatible = "mediatek,adc_channel";
				mediatek,adc_fdd_rf_params_dynamic_custom_ch = <0x4>;
				mediatek,temperature0 = <0x0>;
				mediatek,temperature1 = <0x1>;
				status = "okay";
			};
		};
	};

	fragment@19 {
		target = <0xffffffff>;

		__overlay__ {
			io-channels = <0xffffffff 0x4>;
		};
	};

	fragment@2 {
		target = <0xffffffff>;

		__overlay__ {
			clock-frequency = <0x61a80>;
			pinctrl-0 = <0x1>;
			pinctrl-1 = <0x2>;
			pinctrl-2 = <0x3>;
			pinctrl-3 = <0x4>;
			pinctrl-4 = <0x5>;
			pinctrl-names = "default", "ts_int_active", "ts_reset_active", "ts_int_suspend", "ts_reset_suspend";
			status = "okay";

			gt9886@5d {
				compatible = "goodix,gt9886";
				goodix,config-version = "6785v99";
				goodix,firmware-version = "6785ae";
				goodix,irq-flags = <0x2>;
				goodix,irq-gpio = <0xffffffff 0x1 0x0>;
				goodix,key-of-pen = <0x14b 0x14c>;
				goodix,panel-key-map = <0x9e 0xac 0xd9>;
				goodix,panel-max-id = <0xa>;
				goodix,panel-max-p = <0x100>;
				goodix,panel-max-w = <0x100>;
				goodix,panel-max-x = <0x438>;
				goodix,panel-max-y = <0x870>;
				goodix,pen-enable;
				goodix,power-off-delay-us = <0x1388>;
				goodix,power-on-delay-us = <0x2710>;
				goodix,reset-gpio = <0xffffffff 0x2 0x0>;
				goodix,x2x;
				goodix,y2y;
				interrupt-parent = <0xffffffff>;
				interrupts = <0x1 0x2 0x1 0x0>;
				reg = <0x5d>;
				status = "ok";
				vtouch-supply = <0xffffffff>;

				sensor0 {
					normal-cfg;
				};
			};
		};
	};

	fragment@20 {
		target = <0xffffffff>;

		__overlay__ {
			mediatek,clkbuf-config = <0x2 0x1 0x1 0x2 0x0 0x0 0x1>;
			mediatek,clkbuf-controls-for-desense = <0x0 0x4 0x0 0x3 0x0 0x0 0x0>;
			mediatek,clkbuf-output-impedance = <0x4 0x4 0x4 0x4 0x0 0x0 0x4>;
			mediatek,clkbuf-quantity = <0x7>;
			status = "okay";
		};
	};

	fragment@21 {
		target = <0xffffffff>;

		__overlay__ {
			#address-cells = <0x1>;
			#size-cells = <0x0>;
			clock-frequency = <0x61a80>;
			mediatek,use-open-drain;

			cap_touch@14 {
				compatible = "mediatek,cap_touch";
				phandle = <0x2f>;
				reg = <0x14>;
				status = "okay";
			};

			i2c_lcd_bias@11 {
				compatible = "mediatek,i2c_lcd_bias";
				phandle = <0x30>;
				reg = <0x11>;
				status = "okay";
			};
		};
	};

	fragment@22 {
		target = <0xffffffff>;

		__overlay__ {
			#address-cells = <0x1>;
			#size-cells = <0x0>;
			clock-frequency = <0x61a80>;
			mediatek,use-open-drain;
		};
	};

	fragment@23 {
		target = <0xffffffff>;

		__overlay__ {
			#address-cells = <0x1>;
			#size-cells = <0x0>;
			clock-frequency = <0x61a80>;
			mediatek,use-open-drain;

			camera_main@1a {
				compatible = "mediatek,camera_main";
				phandle = <0x31>;
				reg = <0x1a>;
				status = "okay";
			};

			camera_main_af@0c {
				compatible = "mediatek,camera_main_af";
				phandle = <0x32>;
				reg = <0xc>;
				status = "okay";
			};

			camera_main_eeprom@50 {
				compatible = "mediatek,camera_main_eeprom";
				phandle = <0x33>;
				reg = <0x50>;
				status = "okay";
			};

			ccu_sensor_i2c_main_hw@33 {
				compatible = "mediatek,ccu_sensor_i2c_main_hw";
				phandle = <0x34>;
				reg = <0x33>;
				status = "okay";
			};
		};
	};

	fragment@24 {
		target = <0xffffffff>;

		__overlay__ {
			#address-cells = <0x1>;
			#size-cells = <0x0>;
			clock-frequency = <0x61a80>;
			mediatek,use-open-drain;

			nfc@08 {
				compatible = "mediatek,nfc";
				phandle = <0x35>;
				reg = <0x8>;
				status = "okay";
			};
		};
	};

	fragment@25 {
		target = <0xffffffff>;

		__overlay__ {
			#address-cells = <0x1>;
			#size-cells = <0x0>;
			clock-frequency = <0x61a80>;
			mediatek,use-open-drain;

			camera_sub@2d {
				compatible = "mediatek,camera_sub";
				phandle = <0x36>;
				reg = <0x2d>;
				status = "okay";
			};

			camera_sub_eeprom@52 {
				compatible = "mediatek,camera_sub_eeprom";
				phandle = <0x37>;
				reg = <0x52>;
				status = "okay";
			};

			camera_sub_two@2e {
				compatible = "mediatek,camera_sub_two";
				phandle = <0x39>;
				reg = <0x2e>;
				status = "okay";
			};

			camera_sub_two_af@18 {
				compatible = "mediatek,camera_sub_two_af";
				phandle = <0x3a>;
				reg = <0x18>;
				status = "okay";
			};

			camera_sub_two_eeprom@a2 {
				compatible = "mediatek,camera_sub_two_eeprom";
				phandle = <0x3b>;
				reg = <0xa2>;
				status = "okay";
			};

			ccu_sensor_i2c_sub2_hw@12 {
				compatible = "mediatek,ccu_sensor_i2c_sub2_hw";
				phandle = <0x3c>;
				reg = <0x12>;
				status = "okay";
			};

			ccu_sensor_i2c_sub_hw@43 {
				compatible = "mediatek,ccu_sensor_i2c_sub_hw";
				phandle = <0x38>;
				reg = <0x43>;
				status = "okay";
			};
		};
	};

	fragment@26 {
		target = <0xffffffff>;

		__overlay__ {
			#address-cells = <0x1>;
			#size-cells = <0x0>;
			clock-frequency = <0x33e140>;
			mediatek,use-push-pull;

			subpmic@34 {
				compatible = "mediatek,subpmic";
				phandle = <0x3d>;
				reg = <0x34>;
				status = "okay";
			};

			subpmic_ldo@64 {
				compatible = "mediatek,subpmic_ldo";
				phandle = <0x40>;
				reg = <0x64>;
				status = "okay";
			};

			subpmic_pmic@1a {
				compatible = "mediatek,subpmic_pmic";
				phandle = <0x3f>;
				reg = <0x1a>;
				status = "okay";
			};

			usb_type_c@4e {
				compatible = "mediatek,usb_type_c";
				phandle = <0x3e>;
				reg = <0x4e>;
				status = "okay";
			};
		};
	};

	fragment@27 {
		target = <0xffffffff>;

		__overlay__ {
			#address-cells = <0x1>;
			#size-cells = <0x0>;
			clock-frequency = <0x61a80>;
			mediatek,use-open-drain;

			speaker_amp@34 {
				compatible = "mediatek,speaker_amp";
				phandle = <0x41>;
				reg = <0x34>;
				status = "okay";
			};
		};
	};

	fragment@28 {
		target = <0xffffffff>;

		__overlay__ {
			#address-cells = <0x1>;
			#size-cells = <0x0>;
			clock-frequency = <0x61a80>;
			mediatek,use-open-drain;

			camera_main_two@10 {
				compatible = "mediatek,camera_main_two";
				phandle = <0x42>;
				reg = <0x10>;
				status = "okay";
			};

			camera_main_two_af@0c {
				compatible = "mediatek,camera_main_two_af";
				phandle = <0x43>;
				reg = <0xc>;
				status = "okay";
			};

			camera_main_two_eeprom@50 {
				compatible = "mediatek,camera_main_two_eeprom";
				phandle = <0x44>;
				reg = <0x50>;
				status = "okay";
			};

			ccu_sensor_i2c_main2_hw@36 {
				compatible = "mediatek,ccu_sensor_i2c_main2_hw";
				phandle = <0x45>;
				reg = <0x36>;
				status = "okay";
			};

			ccu_sensor_i2c_main3_hw@11 {
				compatible = "mediatek,ccu_sensor_i2c_main3_hw";
				phandle = <0x46>;
				reg = <0x11>;
				status = "okay";
			};
		};
	};

	fragment@29 {
		target = <0xffffffff>;

		__overlay__ {
			#address-cells = <0x1>;
			#size-cells = <0x0>;
			clock-frequency = <0x61a80>;
			mediatek,use-open-drain;
		};
	};

	fragment@3 {
		target = <0xffffffff>;

		__overlay__ {
			pinctrl-0 = <0x6>;
			pinctrl-1 = <0x7>;
			pinctrl-2 = <0x8>;
			pinctrl-3 = <0x9>;
			pinctrl-4 = <0xa>;
			pinctrl-5 = <0xb>;
			pinctrl-names = "default", "state_eint_as_int", "state_eint_output0", "state_eint_output1", "state_rst_output0", "state_rst_output1";
			status = "okay";
			tpd-filter-custom-prameters = <0x0 0x0 0x0 0x0 0x0 0x0 0x0 0x0 0x0 0x0 0x0 0x0>;
			tpd-filter-custom-speed = <0x0 0x0 0x0>;
			tpd-filter-enable = <0x1>;
			tpd-filter-pixel-density = <0xa8>;
			tpd-key-dim-local = <0x5a 0x373 0x64 0x28 0xe6 0x373 0x64 0x28 0x172 0x373 0x64 0x28 0x0 0x0 0x0 0x0>;
			tpd-key-local = <0x8b 0xac 0x9e 0x0>;
			tpd-key-num = <0x3>;
			tpd-max-touch-num = <0xa>;
			tpd-resolution = <0x438 0x870>;
			use-tpd-button = <0x0>;
		};
	};

	fragment@30 {
		target = <0xffffffff>;

		__overlay__ {
			#address-cells = <0x1>;
			#size-cells = <0x0>;
			clock-frequency = <0x33e140>;
			mediatek,use-open-drain;

			vproc_buck@6b {
				compatible = "mediatek,vproc_buck";
				phandle = <0x47>;
				reg = <0x6b>;
				status = "okay";
			};
		};
	};

	fragment@31 {
		target = <0xffffffff>;

		__overlay__ {
			GPIO_SIM1_HOT_PLUG = <0xffffffff 0x8c 0x0>;
			GPIO_SIM1_SCLK = <0xffffffff 0x82 0x0>;
			GPIO_SIM1_SIO = <0xffffffff 0x80 0x0>;
			GPIO_SIM1_SRST = <0xffffffff 0x81 0x0>;
			GPIO_SIM2_HOT_PLUG = <0xffffffff 0x8d 0x0>;
			GPIO_SIM2_SCLK = <0xffffffff 0x83 0x0>;
			GPIO_SIM2_SIO = <0xffffffff 0x85 0x0>;
			GPIO_SIM2_SRST = <0xffffffff 0x84 0x0>;
		};
	};

	fragment@32 {
		target = <0xffffffff>;

		__overlay__ {
			gpio_init_default = <0x0 0x0 0x0 0x0 0x1 0x1 0x1 0x1 0x0 0x0 0x0 0x1 0x1 0x1 0x2 0x0 0x1 0x0 0x0 0x0 0x1 0x3 0x0 0x1 0x1 0x0 0x0 0x1 0x4 0x0 0x0 0x0 0x1 0x0 0x1 0x5 0x0 0x0 0x0 0x1 0x1 0x1 0x6 0x0 0x0 0x0 0x1 0x0 0x1 0x7 0x0 0x0 0x0 0x1 0x1 0x1 0x8 0x0 0x0 0x0 0x1 0x1 0x1 0x9 0x0 0x0 0x0 0x1 0x0 0x1 0xa 0x0 0x0 0x0 0x1 0x0 0x1 0xb 0x0 0x0 0x0 0x1 0x1 0x1 0xc 0x0 0x0 0x0 0x1 0x1 0x0 0xd 0x0 0x0 0x0 0x1 0x0 0x0 0xe 0x0 0x1 0x0 0x0 0x0 0x0 0xf 0x0 0x1 0x0 0x0 0x0 0x0 0x10 0x0 0x0 0x0 0x1 0x1 0x1 0x11 0x1 0x0 0x0 0x1 0x0 0x0 0x12 0x1 0x1 0x0 0x0 0x0 0x0 0x13 0x1 0x1 0x0 0x0 0x0 0x0 0x14 0x1 0x1 0x0 0x0 0x0 0x0 0x15 0x0 0x1 0x0 0x0 0x0 0x0 0x16 0x0 0x1 0x1 0x0 0x0 0x0 0x17 0x0 0x1 0x0 0x0 0x0 0x0 0x18 0x0 0x1 0x0 0x0 0x0 0x0 0x19 0x1 0x0 0x0 0x1 0x0 0x0 0x1a 0x0 0x1 0x0 0x0 0x0 0x0 0x1c 0x1 0x0 0x0 0x1 0x1 0x1 0x1d 0x1 0x0 0x0 0x1 0x1 0x1 0x1e 0x0 0x1 0x0 0x0 0x0 0x0 0x1f 0x0 0x1 0x0 0x0 0x0 0x0 0x20 0x0 0x1 0x0 0x0 0x0 0x0 0x21 0x0 0x0 0x0 0x1 0x0 0x0 0x22 0x0 0x1 0x0 0x0 0x0 0x0 0x23 0x5 0x1 0x0 0x0 0x0 0x0 0x24 0x5 0x1 0x0 0x0 0x0 0x0 0x25 0x5 0x0 0x0 0x1 0x0 0x0 0x26 0x5 0x1 0x0 0x0 0x0 0x0 0x27 0x6 0x0 0x0 0x1 0x0 0x0 0x28 0x6 0x0 0x0 0x1 0x0 0x0 0x29 0x6 0x0 0x0 0x1 0x0 0x0 0x2a 0x1 0x1 0x0 0x0 0x0 0x0 0x2b 0x0 0x0 0x0 0x1 0x0 0x0 0x2c 0x0 0x1 0x0 0x0 0x0 0x0 0x2d 0x1 0x0 0x0 0x1 0x1 0x1 0x2e 0x1 0x0 0x0 0x1 0x1 0x1 0x2f 0x1 0x0 0x0 0x1 0x1 0x0 0x30 0x1 0x1 0x1 0x0 0x0 0x0 0x31 0x1 0x1 0x0 0x0 0x0 0x0 0x32 0x1 0x1 0x0 0x0 0x0 0x0 0x33 0x1 0x0 0x0 0x1 0x1 0x1 0x34 0x1 0x0 0x0 0x1 0x1 0x1 0x35 0x1 0x0 0x0 0x1 0x1 0x0 0x36 0x1 0x1 0x1 0x0 0x0 0x0 0x37 0x1 0x0 0x0 0x1 0x1 0x1 0x38 0x1 0x0 0x0 0x1 0x1 0x1 0x39 0x0 0x0 0x0 0x1 0x0 0x0 0x3a 0x0 0x0 0x0 0x1 0x0 0x0 0x3b 0x1 0x0 0x0 0x1 0x1 0x0 0x3c 0x1 0x0 0x0 0x1 0x1 0x0 0x3d 0x2 0x0 0x0 0x1 0x1 0x1 0x3e 0x2 0x0 0x0 0x1 0x1 0x1 0x3f 0x2 0x0 0x0 0x1 0x0 0x0 0x40 0x2 0x1 0x0 0x0 0x0 0x0 0x41 0x2 0x1 0x0 0x0 0x0 0x0 0x42 0x2 0x1 0x0 0x0 0x0 0x0 0x43 0x1 0x1 0x0 0x0 0x0 0x1 0x44 0x1 0x1 0x0 0x0 0x0 0x1 0x45 0x0 0x0 0x0 0x1 0x1 0x1 0x46 0x1 0x0 0x0 0x1 0x0 0x0 0x47 0x1 0x1 0x0 0x0 0x0 0x1 0x48 0x1 0x0 0x0 0x1 0x0 0x0 0x49 0x3 0x0 0x0 0x1 0x0 0x0 0x4a 0x3 0x0 0x0 0x1 0x0 0x0 0x4b 0x1 0x0 0x0 0x1 0x0 0x0 0x4c 0x1 0x0 0x0 0x1 0x0 0x0 0x4d 0x1 0x0 0x0 0x1 0x0 0x0 0x4e 0x1 0x0 0x0 0x1 0x0 0x0 0x4f 0x1 0x0 0x0 0x1 0x0 0x0 0x50 0x1 0x0 0x0 0x1 0x0 0x0 0x51 0x1 0x0 0x0 0x1 0x0 0x0 0x52 0x1 0x0 0x0 0x1 0x0 0x0 0x53 0x1 0x0 0x0 0x1 0x0 0x0 0x54 0x1 0x0 0x0 0x1 0x0 0x0 0x55 0x1 0x0 0x0 0x1 0x0 0x0 0x56 0x1 0x0 0x0 0x1 0x0 0x0 0x57 0x1 0x0 0x0 0x1 0x0 0x0 0x58 0x1 0x0 0x0 0x1 0x0 0x0 0x59 0x1 0x0 0x0 0x1 0x0 0x0 0x5a 0x1 0x0 0x0 0x1 0x0 0x0 0x5b 0x1 0x0 0x0 0x1 0x0 0x0 0x5c 0x1 0x0 0x0 0x1 0x0 0x0 0x5d 0x0 0x1 0x0 0x0 0x0 0x0 0x5e 0x1 0x0 0x0 0x1 0x0 0x0 0x5f 0x1 0x0 0x0 0x1 0x0 0x0 0x60 0x1 0x0 0x0 0x1 0x0 0x0 0x61 0x1 0x0 0x0 0x1 0x0 0x0 0x62 0x1 0x0 0x0 0x1 0x0 0x0 0x63 0x1 0x0 0x0 0x1 0x0 0x0 0x64 0x1 0x0 0x0 0x1 0x0 0x0 0x65 0x1 0x0 0x0 0x1 0x0 0x0 0x66 0x1 0x0 0x0 0x1 0x0 0x0 0x67 0x1 0x0 0x0 0x1 0x0 0x0 0x68 0x1 0x0 0x0 0x1 0x0 0x0 0x69 0x1 0x0 0x0 0x1 0x0 0x0 0x6a 0x1 0x0 0x0 0x1 0x0 0x0 0x6b 0x1 0x0 0x0 0x1 0x0 0x0 0x6c 0x1 0x0 0x0 0x1 0x0 0x0 0x6d 0x1 0x0 0x0 0x1 0x0 0x0 0x6e 0x1 0x0 0x0 0x1 0x1 0x1 0x6f 0x1 0x0 0x0 0x1 0x1 0x1 0x70 0x1 0x0 0x0 0x1 0x1 0x1 0x71 0x1 0x0 0x0 0x1 0x1 0x1 0x72 0x0 0x1 0x0 0x0 0x0 0x0 0x73 0x0 0x1 0x0 0x0 0x0 0x0 0x74 0x1 0x1 0x0 0x0 0x0 0x0 0x75 0x1 0x1 0x0 0x0 0x0 0x0 0x76 0x0 0x1 0x0 0x0 0x0 0x0 0x77 0x0 0x1 0x0 0x0 0x0 0x0 0x78 0x1 0x1 0x0 0x0 0x0 0x0 0x79 0x1 0x1 0x0 0x0 0x0 0x0 0x7a 0x0 0x1 0x0 0x0 0x0 0x0 0x7b 0x0 0x1 0x0 0x0 0x0 0x0 0x7c 0x0 0x1 0x0 0x0 0x0 0x0 0x7d 0x0 0x1 0x0 0x0 0x0 0x0 0x7e 0x0 0x1 0x0 0x0 0x0 0x0 0x7f 0x0 0x1 0x0 0x0 0x0 0x0 0x80 0x1 0x0 0x0 0x1 0x1 0x1 0x81 0x1 0x1 0x0 0x0 0x0 0x1 0x82 0x1 0x1 0x0 0x0 0x0 0x1 0x83 0x1 0x1 0x0 0x0 0x0 0x1 0x84 0x1 0x1 0x0 0x0 0x0 0x1 0x85 0x1 0x0 0x0 0x1 0x1 0x1 0x86 0x1 0x1 0x0 0x0 0x0 0x1 0x87 0x1 0x0 0x0 0x1 0x1 0x1 0x88 0x1 0x0 0x0 0x1 0x1 0x1 0x89 0x1 0x0 0x0 0x1 0x1 0x1 0x8a 0x1 0x0 0x0 0x1 0x1 0x1 0x8b 0x1 0x0 0x0 0x1 0x1 0x1 0x8c 0x1 0x0 0x0 0x1 0x1 0x1 0x8d 0x1 0x0 0x0 0x1 0x1 0x1 0x8e 0x1 0x1 0x0 0x0 0x0 0x0 0x8f 0x1 0x1 0x0 0x0 0x0 0x1 0x90 0x1 0x1 0x0 0x0 0x0 0x1 0x91 0x1 0x1 0x0 0x0 0x0 0x1 0x92 0x1 0x0 0x0 0x1 0x0 0x1 0x93 0x0 0x0 0x0 0x1 0x0 0x0 0x94 0x0 0x0 0x0 0x1 0x0 0x0 0x95 0x0 0x0 0x0 0x1 0x0 0x0 0x96 0x4 0x1 0x0 0x0 0x0 0x0 0x97 0x1 0x0 0x0 0x1 0x1 0x1 0x98 0x1 0x0 0x0 0x1 0x1 0x1 0x99 0x0 0x0 0x0 0x1 0x0 0x0 0x9a 0x1 0x0 0x0 0x0 0x0 0x1 0x9b 0x1 0x0 0x0 0x0 0x0 0x1 0x9c 0x0 0x1 0x0 0x0 0x0 0x0 0x9d 0x0 0x1 0x0 0x0 0x0 0x0 0x9e 0x0 0x1 0x0 0x0 0x0 0x0 0x9f 0x0 0x1 0x0 0x0 0x0 0x0 0xa0 0x0 0x1 0x0 0x0 0x0 0x0 0xa1 0x0 0x1 0x0 0x0 0x0 0x0 0xa2 0x0 0x1 0x0 0x0 0x0 0x0 0xa3 0x0 0x1 0x0 0x0 0x0 0x0 0xa4 0x0 0x1 0x0 0x0 0x0 0x0 0xa5 0x0 0x0 0x0 0x1 0x0 0x0 0xa6 0x0 0x0 0x0 0x1 0x0 0x0 0xb3 0x1 0x0 0x0 0x1 0x0 0x0 0xb4 0x1 0x0 0x0 0x1 0x0 0x0 0xb5 0x1 0x1 0x0 0x0 0x0 0x0 0xb6 0x1 0x1 0x0 0x0 0x0 0x0 0xb7 0x1 0x1 0x0 0x0 0x0 0x0 0xb8 0x1 0x0 0x0 0x1 0x0 0x0 0xb9 0x1 0x1 0x0 0x0 0x0 0x0 0xba 0x1 0x0 0x0 0x1 0x0 0x0 0xbb 0x1 0x1 0x0 0x0 0x0 0x0 0xbc 0x1 0x0 0x0 0x1 0x0 0x1 0xbd 0x1 0x1 0x0 0x0 0x0 0x1 0xbe 0x1 0x1 0x0 0x0 0x0 0x1 0xbf 0x1 0x1 0x0 0x0 0x0 0x1 0xc0 0x1 0x1 0x0 0x0 0x0 0x1 0xc1 0x1 0x0 0x0 0x1 0x0 0x1 0xc2 0x1 0x0 0x0 0x1 0x0 0x1 0xc3 0x0 0x1 0x0 0x0 0x0 0x0 0xc4 0x1 0x1 0x0 0x0 0x0 0x0 0xc5 0x0 0x1 0x0 0x0 0x0 0x0 0xc6 0x1 0x0 0x0 0x1 0x1 0x1 0xc7 0x1 0x0 0x0 0x1 0x1 0x1 0xc8 0x1 0x0 0x0 0x1 0x1 0x0 0xc9 0x1 0x1 0x0 0x0 0x0 0x0 0xca 0x0 0x1 0x0 0x0 0x0 0x0 0xcb 0x0 0x0 0x0 0x1 0x0 0x0 0xcc 0x0 0x0 0x0 0x1 0x0 0x0 0xcd 0x0 0x0 0x0 0x1 0x0 0x0 0xce 0x0 0x0 0x0 0x1 0x0 0x0 0xcf 0x0 0x0 0x0 0x1 0x0 0x0 0xd0 0x0 0x0 0x0 0x1 0x0 0x0 0xd1 0x0 0x0 0x0 0x1 0x0 0x0 0xd2 0x0 0x0 0x0 0x1 0x0 0x0>;
		};
	};

	fragment@33 {
		target = <0xffffffff>;

		__overlay__ {
			deb-gpios = <0xffffffff 0x0 0x0>;
			debounce = <0x7d000>;
			interrupt-parent = <0xffffffff>;
			interrupts = <0x0 0x8 0x0 0x0>;
			status = "okay";
		};
	};

	fragment@34 {
		target = <0xffffffff>;

		__overlay__ {
			interrupt-parent = <0xffffffff>;
			interrupts = <0x1 0x2 0x1 0x0>;
			status = "okay";
		};
	};

	fragment@35 {
		target = <0xffffffff>;

		__overlay__ {
			interrupt-parent = <0xffffffff>;
			interrupts = <0x7 0x2 0x7 0x0>;
			status = "okay";
		};
	};

	fragment@36 {
		target = <0xffffffff>;

		__overlay__ {
			interrupt-parent = <0xffffffff>;
			interrupts = <0x8 0x8 0x8 0x0>;
			status = "okay";
		};
	};

	fragment@37 {
		target = <0xffffffff>;

		__overlay__ {
			interrupt-parent = <0xffffffff>;
			interrupts = <0x9 0x1 0x9 0x0>;
			status = "okay";
		};
	};

	fragment@38 {
		target = <0xffffffff>;

		__overlay__ {
			interrupt-parent = <0xffffffff>;
			interrupts = <0xd 0x1 0xd 0x0>;
			status = "okay";
		};
	};

	fragment@39 {
		target = <0xffffffff>;

		__overlay__ {
			interrupt-parent = <0xffffffff>;
			interrupts = <0x10 0x2 0x10 0x0>;
			status = "okay";
		};
	};

	fragment@4 {
		target = <0xffffffff>;

		__overlay__ {

			eint0default {
				phandle = <0x6>;
			};

			eint1default {
				phandle = <0x1>;
			};

			eint@0 {
				phandle = <0x7>;

				pins_cmd_dat {
					bias-disable;
					pinmux = <0x100>;
					slew-rate = <0x0>;
				};
			};

			eintoutput0 {
				phandle = <0x8>;

				pins_cmd_dat {
					output-low;
					pinmux = <0x100>;
					slew-rate = <0x1>;
				};
			};

			eintoutput1 {
				phandle = <0x9>;

				pins_cmd_dat {
					output-high;
					pinmux = <0x100>;
					slew-rate = <0x1>;
				};
			};

			int_active {
				phandle = <0x2>;

				pins_cmd_dat {
					bias-pull-up = <0xb>;
					pinmux = <0x100>;
					slew-rate = <0x0>;
				};
			};

			int_suspend {
				phandle = <0x4>;

				pins_cmd_dat {
					output-low;
					pinmux = <0x100>;
					slew-rate = <0x1>;
				};
			};

			reset_active {
				phandle = <0x3>;

				pins_cmd_dat {
					output-high;
					pinmux = <0x200>;
					slew-rate = <0x1>;
				};
			};

			reset_suspend {
				phandle = <0x5>;

				pins_cmd_dat {
					output-low;
					pinmux = <0x200>;
					slew-rate = <0x1>;
				};
			};

			rstoutput0 {
				phandle = <0xa>;

				pins_cmd_dat {
					output-low;
					pinmux = <0x200>;
					slew-rate = <0x1>;
				};
			};

			rstoutput1 {
				phandle = <0xb>;

				pins_cmd_dat {
					output-high;
					pinmux = <0x200>;
					slew-rate = <0x1>;
				};
			};
		};
	};

	fragment@40 {
		target = <0xffffffff>;

		__overlay__ {
			interrupt-parent = <0xffffffff>;
			interrupts = <0x45 0x8 0x45 0x0>;
			status = "okay";
		};
	};

	fragment@41 {
		target = <0xffffffff>;

		__overlay__ {
			interrupt-parent = <0xffffffff>;
			interrupts = <0xc1 0x4 0xd1 0x0>;
			status = "okay";
		};
	};

	fragment@42 {
		target = <0xffffffff>;

		__overlay__ {
			compatible = "mediatek,md1_sim1_hot_plug_eint-eint";
			debounce = <0x0 0x186a0>;
			dedicated = <0x0 0x0>;
			interrupts = <0x0 0x8>;
			sockettype = <0x0 0x0>;
			src_pin = <0x0 0x1>;
			status = "okay";
		};
	};

	fragment@43 {
		target = <0xffffffff>;

		__overlay__ {
			regulator-default-on = <0x1>;
			regulator-name = "vcamio";
			status = "okay";
		};
	};

	fragment@44 {
		target = <0xffffffff>;

		__overlay__ {
			regulator-default-on = <0x1>;
			regulator-name = "vtp";
			status = "okay";
		};
	};

	fragment@45 {
		target = <0xffffffff>;

		__overlay__ {
			status = "okay";
			vcamaf-supply = <0xffffffff>;
			vcamaf_main2-supply = <0xffffffff>;
			vcamaf_sub2-supply = <0xffffffff>;
			vcamio-supply = <0xffffffff>;
			vcamio_main2-supply = <0xffffffff>;
			vcamio_sub-supply = <0xffffffff>;
		};
	};

	fragment@46 {
		target = <0xffffffff>;

		__overlay__ {
			status = "okay";
		};
	};

	fragment@47 {
		target = <0xffffffff>;

		__overlay__ {
			mediatek,kpd-hw-dl-key0 = <0x0>;
			mediatek,kpd-hw-init-map = <0x73 0x72 0x0 0x0 0x0 0x0 0x0 0x0 0x0 0x0 0x0 0x0 0x0 0x0 0x0 0x0 0x0 0x0 0x0 0x0 0x0 0x0 0x0 0x0 0x0 0x0 0x0 0x0 0x0 0x0 0x0 0x0 0x0 0x0 0x0 0x0 0x0 0x0 0x0 0x0 0x0 0x0 0x0 0x0 0x0 0x0 0x0 0x0 0x0 0x0 0x0 0x0 0x0 0x0 0x0 0x0 0x0 0x0 0x0 0x0 0x0 0x0 0x0 0x0 0x0 0x0 0x0 0x0 0x0 0x0 0x0 0x0>;
			mediatek,kpd-hw-map-num = <0x48>;
			mediatek,kpd-hw-pwrkey = <0x8>;
			mediatek,kpd-key-debounce = <0x400>;
			mediatek,kpd-pwkey-gpio-din = <0x0>;
			mediatek,kpd-pwrkey-eint-gpio = <0x0>;
			mediatek,kpd-sw-pwrkey = <0x74>;
			mediatek,kpd-use-extend-type = <0x0>;
			status = "okay";
		};
	};

	fragment@5 {
		target = <0xffffffff>;

		__overlay__ {
			clock-frequency = <0x61a80>;

			mtk-usb@60 {
				compatible = "mediatek,mtk-usb";
				reg = <0x60>;
				status = "okay";
			};
		};
	};

	fragment@6 {
		target = <0xffffffff>;

		__overlay__ {
			accdet-mic-mode = <0x2>;
			accdet-mic-vol = <0x8>;
			accdet-plugout-debounce = <0x1>;
			eint_use_ext_res = <0x4>;
			headset-four-key-threshold = <0x0 0x3a 0x79 0xc0 0x190>;
			headset-mode-setting = <0x500 0x500 0x1 0x1f0 0x800 0x1000 0x20 0x44 0x4 0x1 0x5 0x3 0x3 0x5 0xe>;
			headset-three-key-threshold = <0x0 0x50 0xdc 0x190>;
			headset-three-key-threshold-CDD = <0x0 0x79 0xc0 0x258>;
			status = "okay";
		};
	};

	fragment@7 {
		target = <0xffffffff>;

		__overlay__ {

			led@0 {
				compatible = "mediatek,red";
				data = <0x1>;
				led_mode = <0x0>;
				phandle = <0x26>;
				pwm_config = <0x0 0x0 0x0 0x0 0x0>;
			};

			led@1 {
				compatible = "mediatek,green";
				data = <0x1>;
				led_mode = <0x0>;
				phandle = <0x27>;
				pwm_config = <0x0 0x0 0x0 0x0 0x0>;
			};

			led@2 {
				compatible = "mediatek,blue";
				data = <0x1>;
				led_mode = <0x0>;
				phandle = <0x28>;
				pwm_config = <0x0 0x0 0x0 0x0 0x0>;
			};

			led@3 {
				compatible = "mediatek,jogball-backlight";
				data = <0x1>;
				led_mode = <0x0>;
				phandle = <0x29>;
				pwm_config = <0x0 0x0 0x0 0x0 0x0>;
			};

			led@4 {
				compatible = "mediatek,keyboard-backlight";
				data = <0x1>;
				led_mode = <0x0>;
				phandle = <0x2a>;
				pwm_config = <0x0 0x0 0x0 0x0 0x0>;
			};

			led@5 {
				compatible = "mediatek,button-backlight";
				data = <0x1>;
				led_mode = <0x0>;
				phandle = <0x2b>;
				pwm_config = <0x0 0x0 0x0 0x0 0x0>;
			};

			led@6 {
				compatible = "mediatek,lcd-backlight";
				data = <0x1>;
				led_bits = <0xb>;
				led_mode = <0x5>;
				phandle = <0x2c>;
				pwm_config = <0x0 0x6 0x0 0x0 0x0>;
			};

			usb_c_pinctrl {
				compatible = "mediatek,usb_c_pinctrl";
				phandle = <0x2e>;
				pinctrl-0 = <0xc>;
				pinctrl-1 = <0xd>;
				pinctrl-10 = <0x16>;
				pinctrl-11 = <0x17>;
				pinctrl-12 = <0x18>;
				pinctrl-2 = <0xe>;
				pinctrl-3 = <0xf>;
				pinctrl-4 = <0x10>;
				pinctrl-5 = <0x11>;
				pinctrl-6 = <0x12>;
				pinctrl-7 = <0x13>;
				pinctrl-8 = <0x14>;
				pinctrl-9 = <0x15>;
				pinctrl-names = "usb_default", "redrv_c1_init", "redrv_c1_low", "redrv_c1_hiz", "redrv_c1_high", "redrv_c2_init", "redrv_c2_low", "redrv_c2_hiz", "redrv_c2_high", "switch_sel1", "switch_sel2", "switch_enable", "switch_disable";
				status = "okay";

				usb_switch-data {
					c1_pin_num = <0x1f>;
					c1_pin_val = <0x2>;
					c2_pin_num = <0x1e>;
					c2_pin_val = <0x1>;
					en_pin_num = <0x0>;
					en_pin_val = <0x0>;
					sel_pin_num = <0x20>;
					sel_pin_val = <0x1>;
				};
			};

			vibrator@0 {
				compatible = "mediatek,vibrator";
				phandle = <0x2d>;
				vib_limit = <0x9>;
				vib_timer = <0x19>;
				vib_vol = <0x9>;
			};
		};
	};

	fragment@8 {
		target = <0xffffffff>;

		__overlay__ {

			lcd_bias_enn0_gpio {
				phandle = <0x1c>;

				pins_cmd_dat {
					output-low;
					pinmux = <0xca00>;
					slew-rate = <0x1>;
				};
			};

			lcd_bias_enn1_gpio {
				phandle = <0x1b>;

				pins_cmd_dat {
					output-high;
					pinmux = <0xca00>;
					slew-rate = <0x1>;
				};
			};

			lcd_bias_enp0_gpio {
				phandle = <0x1a>;

				pins_cmd_dat {
					output-low;
					pinmux = <0x1700>;
					slew-rate = <0x1>;
				};
			};

			lcd_bias_enp1_gpio {
				phandle = <0x19>;

				pins_cmd_dat {
					output-high;
					pinmux = <0x1700>;
					slew-rate = <0x1>;
				};
			};

			lcm_dsi_te {
				phandle = <0x1f>;

				pins_cmd_dat {
					pinmux = <0x2b01>;
				};
			};

			lcm_rst_out0_gpio {
				phandle = <0x1e>;

				pins_cmd_dat {
					output-low;
					pinmux = <0x2c00>;
					slew-rate = <0x1>;
				};
			};

			lcm_rst_out1_gpio {
				phandle = <0x1d>;

				pins_cmd_dat {
					output-high;
					pinmux = <0x2c00>;
					slew-rate = <0x1>;
				};
			};
		};
	};

	fragment@9 {
		target = <0xffffffff>;

		__overlay__ {
			pinctrl-0 = <0x19>;
			pinctrl-1 = <0x1a>;
			pinctrl-2 = <0x1b>;
			pinctrl-3 = <0x1c>;
			pinctrl-4 = <0x1d>;
			pinctrl-5 = <0x1e>;
			pinctrl-6 = <0x1f>;
			pinctrl-names = "lcd_bias_enp1_gpio", "lcd_bias_enp0_gpio", "lcd_bias_enn1_gpio", "lcd_bias_enn0_gpio", "lcm_rst_out1_gpio", "lcm_rst_out0_gpio", "mode_te_te";
			status = "okay";
		};
	};
};
